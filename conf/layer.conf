## conf/layer.conf
```bitbake
# We have a conf and classes directory, add to BBPATH
BBPATH .= ":${LAYERDIR}"

# We have recipes-* directories, add to BBFILES
BBFILES += "${LAYERDIR}/recipes-*/*/*.bb \
            ${LAYERDIR}/recipes-*/*/*.bbappend"

BBFILE_COLLECTIONS += "meta-robomagister-engicam"
BBFILE_PATTERN_meta-robomagister-engicam = "^${LAYERDIR}/"
BBFILE_PRIORITY_meta-robomagister-engicam = "6"

LAYERDEPENDS_meta-robomagister-engicam = "core"
LAYERSERIES_COMPAT_meta-robomagister-engicam = "kirkstone"
```
